## virt/drivers/bluetooth_rfkill/Kconfig
```kconfig
menu "Bluetooth Rfkill device drivers"
	depends on RFKILL

config BRCM_BT
	tristate "Broadcom Bluetooth RFKILL driver"
	depends on RFKILL
	default m
	help
	  Provides a parameter to switch on/off power from PMIC
	  to Broadcom Bluetooth device.

endmenu
```

## virt/sound/soc/mediatek/Kconfig
```kconfig
config MT_SND_SOC_8127
	bool "MT_SND_SOC_8127"
	default y
	help
        If you say Y, enable MT_SND_SOC_8127_driver.
        Must enable this to use medatek 8127 audio driver.
	The default value is n for MT8127.
        Recommnad to configure it before using MT8127 audio driver.
```
